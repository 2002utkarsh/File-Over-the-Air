## zephyrproject/build_app/Kconfig/boards/Kconfig.defconfig
```kconfig
# Load Zephyr board defconfig descriptions.
osource "C:/UG/Uni/FOTO_Project/zephyrproject/zephyr/boards/native/native_sim/Kconfig.defconfig"
```

## zephyrproject/build_native/Kconfig/arch/Kconfig
```kconfig
# Load Zephyr Arch Kconfig descriptions.
osource "C:/UG/Uni/FOTO_Project/zephyrproject/zephyr/arch/rx/Kconfig"
osource "C:/UG/Uni/FOTO_Project/zephyrproject/zephyr/arch/x86/Kconfig"
osource "C:/UG/Uni/FOTO_Project/zephyrproject/zephyr/arch/xtensa/Kconfig"
osource "C:/UG/Uni/FOTO_Project/zephyrproject/zephyr/arch/sparc/Kconfig"
osource "C:/UG/Uni/FOTO_Project/zephyrproject/zephyr/arch/riscv/Kconfig"
osource "C:/UG/Uni/FOTO_Project/zephyrproject/zephyr/arch/posix/Kconfig"
osource "C:/UG/Uni/FOTO_Project/zephyrproject/zephyr/arch/mips/Kconfig"
osource "C:/UG/Uni/FOTO_Project/zephyrproject/zephyr/arch/arm64/Kconfig"
osource "C:/UG/Uni/FOTO_Project/zephyrproject/zephyr/arch/arm/Kconfig"
osource "C:/UG/Uni/FOTO_Project/zephyrproject/zephyr/arch/arc/Kconfig"
```

## zephyrproject/imu_logger/build/Kconfig/arch/Kconfig
```kconfig
# Load Zephyr Arch Kconfig descriptions.
osource "C:/UG/Uni/Capstone_Embedded/zephyrproject/zephyr/arch/rx/Kconfig"
osource "C:/UG/Uni/Capstone_Embedded/zephyrproject/zephyr/arch/x86/Kconfig"
osource "C:/UG/Uni/Capstone_Embedded/zephyrproject/zephyr/arch/xtensa/Kconfig"
osource "C:/UG/Uni/Capstone_Embedded/zephyrproject/zephyr/arch/sparc/Kconfig"
osource "C:/UG/Uni/Capstone_Embedded/zephyrproject/zephyr/arch/riscv/Kconfig"
osource "C:/UG/Uni/Capstone_Embedded/zephyrproject/zephyr/arch/posix/Kconfig"
osource "C:/UG/Uni/Capstone_Embedded/zephyrproject/zephyr/arch/mips/Kconfig"
osource "C:/UG/Uni/Capstone_Embedded/zephyrproject/zephyr/arch/arm64/Kconfig"
osource "C:/UG/Uni/Capstone_Embedded/zephyrproject/zephyr/arch/arm/Kconfig"
osource "C:/UG/Uni/Capstone_Embedded/zephyrproject/zephyr/arch/arc/Kconfig"
```

## zephyrproject/imu_logger/build/Kconfig/boards/Kconfig.arduino_nano_33_ble
```kconfig
# Load board Kconfig descriptions.
osource "C:/UG/Uni/Capstone_Embedded/zephyrproject/zephyr/boards/arduino/nano_33_ble/Kconfig.arduino_nano_33_ble"
```

## zephyrproject/imu_logger/build/Kconfig/boards/Kconfig.defconfig
```kconfig
# Load Zephyr board defconfig descriptions.
osource "C:/UG/Uni/Capstone_Embedded/zephyrproject/zephyr/boards/arduino/nano_33_ble/Kconfig.defconfig"
```

## zephyrproject/imu_logger/build/Kconfig/boards/Kconfig.sysbuild
```kconfig
# Load Sysbuild board Kconfig descriptions.
osource "C:/UG/Uni/Capstone_Embedded/zephyrproject/zephyr/boards/arduino/nano_33_ble/Kconfig.sysbuild"
```
